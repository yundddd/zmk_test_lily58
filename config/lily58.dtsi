/ {
    right_encoder: encoder_right {
        compatible = "alps,ec11";
        a-gpios = <&pro_micro 21 (GPIO_ACTIVE_HIGH | GPIO_PULL_UP)>; // change these
        b-gpios = <&pro_micro 20 (GPIO_ACTIVE_HIGH | GPIO_PULL_UP)>;
        resolution = <2>;
    };
};

&left_encoder { resolution = <2>; };

&sensors {
    sensors = <&left_encoder &right_encoder>;
}
